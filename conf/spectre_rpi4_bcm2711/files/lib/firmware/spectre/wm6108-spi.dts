/dts-v1/;
/plugin/;

/*
 * Seeed Wio-WM6108 in the WM1302 Pi HAT mini-PCIe socket (SenseCAP M1).
 * SPI0 CE0 is GPIO8. The card's mPCIe fingers land on the HAT as:
 *   reset GPIO17, IRQ GPIO5, wake GPIO23, busy GPIO24.
 * Applied at runtime. It is not listed in config.txt, so SPI stays with
 * the SX1302 until SpectreOS selects this card.
 */
/ {
	compatible = "brcm,bcm2835", "brcm,bcm2711";

	fragment@0 {
		target = <&spi0>;
		__overlay__ {
			#address-cells = <1>;
			#size-cells = <0>;
			status = "okay";

			spidev@0 {
				reg = <0>;
				status = "disabled";
			};

			mm6108@0 {
				compatible = "morse,mm610x-spi";
				reg = <0>;
				spi-max-frequency = <20000000>;
				reset-gpios = <&gpio 17 0>;
				spi-irq-gpios = <&gpio 5 0>;
				power-gpios = <&gpio 23 0>, <&gpio 24 0>;
				status = "okay";
			};
		};
	};
};
